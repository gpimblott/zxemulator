## esp32/sdkconfig.defaults
```kconfig
CONFIG_FREERTOS_HZ=1000
CONFIG_COMPILER_CXX_EXCEPTIONS=y
CONFIG_TFT_MISO=19
CONFIG_TFT_MOSI=23
CONFIG_TFT_SCLK=18
CONFIG_TFT_CS=15
CONFIG_TFT_DC=2
CONFIG_TFT_RST=4
CONFIG_TFT_BL=32
CONFIG_TFT_MISO=19
CONFIG_TFT_MOSI=23
CONFIG_TFT_SCLK=18
CONFIG_TFT_CS=5
CONFIG_TFT_DC=27
CONFIG_TFT_RST=26
CONFIG_TFT_ILI9341_DRIVER=y
CONFIG_TFT_WIDTH=240
CONFIG_TFT_HEIGHT=320
CONFIG_TFT_SPI_FREQUENCY=40000000
CONFIG_TFT_SMOOTH_FONT=n
CONFIG_COMPILER_OPTIMIZATION_PERF=y
CONFIG_ESP_DEFAULT_CPU_FREQ_MHZ_240=y
CONFIG_ESP_DEFAULT_CPU_FREQ_MHZ=240

# BT/BLE Configuration
CONFIG_BT_ENABLED=y
CONFIG_BT_BLE_ENABLED=y
CONFIG_BT_BLUEDROID_ENABLED=y
CONFIG_BT_CLASSIC_ENABLED=n
CONFIG_BT_NIMBLE_ENABLED=n
CONFIG_ESP_HIDD_ENABLED=n
CONFIG_ESP_HIDH_ENABLED=y

# Custom Partition Table
CONFIG_PARTITION_TABLE_CUSTOM=y
CONFIG_PARTITION_TABLE_CUSTOM_FILENAME="partitions.csv"
CONFIG_PARTITION_TABLE_FILENAME="partitions.csv"

# Flash Size
CONFIG_ESPTOOLPY_FLASHSIZE_4MB=y
CONFIG_ESPTOOLPY_FLASHSIZE="4MB"
```
